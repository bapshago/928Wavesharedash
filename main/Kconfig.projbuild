## main/Kconfig.projbuild
```kconfig
menu "928 EV Dash"

    choice DASH_SIDE
        prompt "Screen side"
        default DASH_SIDE_LEFT
        help
            The car has two identical dash units running the same firmware.
            This picks which gauges this unit shows on its driver page.

        config DASH_SIDE_LEFT
            bool "Left: speed, drive direction, odometer, state of charge"
        config DASH_SIDE_RIGHT
            bool "Right: current, voltage, 12V, temperatures, op mode, charger"
    endchoice

    choice DASH_CHIP_REV
        prompt "ESP32-P4 chip revision"
        default DASH_CHIP_REV_V1
        help
            Waveshare boards ship with either ESP32-P4 silicon v1.x (older boards)
            or v3.x (newer boards), and firmware built for one won't flash on the
            other ("requires chip revision in range ..."). The boot log and
            esptool print the revision; pick the one for the board you're
            flashing. This sets ESP-IDF's own chip revision options to match.

        config DASH_CHIP_REV_V1
            bool "v1.x (older boards, e.g. v1.3)"
            select ESP32P4_SELECTS_REV_LESS_V3
        config DASH_CHIP_REV_V3
            bool "v3.x (newer boards, e.g. v3.2)"
    endchoice

    config DASH_CAN_TX_GPIO
        int "CAN transceiver TX GPIO (to transceiver D/TXD)"
        range 0 54
        default 35
        help
            ESP32-P4 GPIO wired to the CAN transceiver's TXD input (SN65HVD230 pin D,
            "CTX" on the common breakout). GPIO35 is also the chip's BOOT strapping
            pin: that's fine because the transceiver input doesn't pull it low at
            reset, but holding the BOOT button drives the CAN bus dominant.

    config DASH_CAN_RX_GPIO
        int "CAN transceiver RX GPIO (from transceiver R/RXD)"
        range 0 54
        default 36
        help
            ESP32-P4 GPIO wired to the CAN transceiver's RXD output (SN65HVD230 pin R,
            "CRX" on the common breakout).

    config DASH_CAN_BITRATE
        int "CAN bitrate (bit/s)"
        default 500000
        help
            Nissan Leaf EV-CAN / ZombieVerter bus speed.

    config DASH_CAN_LISTEN_ONLY
        bool "Listen-only (never ACK or transmit)"
        default n
        help
            The web dash ran the controller in normal mode, which ACKs frames.
            Listen-only guarantees the dash can never disturb the bus, but on a
            bench with a single transmitter nothing will ACK its frames.

    config DASH_TEST_MODE
        bool "Test mode: animated fake data instead of CAN"
        default n
        help
            Like TEST_MODE = true in the web dash, but every gauge sweeps its
            full range linearly (up over 10 s, back down over 10 s; SOC runs
            100 % → 0 %) and on/off states step through their values, so the
            screen can be checked without a CAN bus connected. The odometer
            does not count test-mode distance.

    menu "Speed and odometer calibration"
        comment "Speed and the odometer are calculated from these. Wrong values misreport mileage, which is illegal."

        choice DASH_TIRE_INPUT
            prompt "Tyre size given as"
            default DASH_TIRE_BY_CIRCUMFERENCE
            help
                How the dash learns the driven wheels' tyre size. Speed and the
                odometer are calculated from motor RPM, the gear ratio and this
                size, so a wrong value misreports both. Misrepresenting a car's
                mileage is illegal (in the U.S., 49 U.S.C. 32703); see "Odometer
                and the law" in README.md. A measured rolling circumference is the
                most accurate.

            config DASH_TIRE_BY_CIRCUMFERENCE
                bool "Rolling circumference (measured)"
            config DASH_TIRE_BY_SIZE
                bool "Tyre size from the sidewall (e.g. 245/45R16)"
        endchoice

        config DASH_TIRE_CIRCUMFERENCE_MM
            int "Rolling circumference (mm)"
            depends on DASH_TIRE_BY_CIRCUMFERENCE
            range 1000 3000
            default 1975
            help
                Distance the car travels for one turn of a driven wheel. Measure it
                by marking the tyre and rolling the car one full turn, with the car
                on its wheels at normal pressure. 1975 mm is the value carried over
                from the web dash.

        config DASH_TIRE_WIDTH_MM
            int "Tyre width (mm), e.g. 245 in 245/45R16"
            depends on DASH_TIRE_BY_SIZE
            range 125 355
            default 245

        config DASH_TIRE_ASPECT_PCT
            int "Profile / aspect ratio (%), e.g. 45 in 245/45R16"
            depends on DASH_TIRE_BY_SIZE
            range 20 90
            default 45

        config DASH_TIRE_RIM_IN
            int "Rim diameter (inches), e.g. 16 in 245/45R16"
            depends on DASH_TIRE_BY_SIZE
            range 12 24
            default 16

        config DASH_GEAR_RATIO_X1000
            int "Overall gear ratio x 1000 (motor turns per wheel turn)"
            range 1000 20000
            default 7940
            help
                Motor revolutions per wheel revolution, times 1000. 7940 is the
                Nissan Leaf reduction gear (7.94:1). If the motor drives through
                another gearbox or differential, enter the overall ratio.
    endmenu

    config DASH_BRIGHTNESS
        int "Backlight brightness (%)"
        range 5 100
        default 100

endmenu
```
